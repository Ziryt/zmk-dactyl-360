## boards/shields/dactyl_360/KConfig.defconfig
```kconfig
if SHIELD_DACTYL_360_LEFT

config ZMK_KEYBOARD_NAME
    default "Dactyl 360"

config ZMK_SPLIT_ROLE_CENTRAL
    default y

endif

if SHIELD_DACTYL_360_LEFT || SHIELD_DACTYL_360_RIGHT

config ZMK_SPLIT
    default y

endif
```

## config/boards/shields/dac360/Kconfig.defconfig
```kconfig
if SHIELD_DAC360_LEFT

config ZMK_KEYBOARD_NAME
	default "Dac360"

config ZMK_SPLIT_BLE_ROLE_CENTRAL
	default y

endif

if SHIELD_DAC360_LEFT || SHIELD_DAC360_RIGHT

config ZMK_SPLIT
    default y

config ZMK_SLEEP
    default y
    
config ZMK_IDLE_SLEEP_TIMEOUT
    default 900000
    
config ZMK_EXT_POWER
    default y

config ZMK_BATTERY_REPORTING
    default y

config ZMK_BATTERY_REPORT_INTERVAL
    default 60

config ZMK_POINTING
    default y

endif
```

## config/boards/shields/dac360/Kconfig.shield
```kconfig
config SHIELD_DAC360_LEFT
    def_bool $(shields_list_contains,dac360_left)

config SHIELD_DAC360_RIGHT
    def_bool $(shields_list_contains,dac360_right)
```

## config/west.yml
```yaml
manifest:
  remotes:
    - name: zmkfirmware
      url-base: https://github.com/zmkfirmware
    # - name: loss-and-quick
    #   url-base: https://github.com/loss-and-quick
  projects:
    - name: zmk
      remote: zmkfirmware
      revision: main
      import: app/west.yml
    # - name: zmk-nice-oled
    #   remote: loss-and-quick
    #   revision: main
  self:
    path: config
```
